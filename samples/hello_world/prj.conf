## prj.conf
```kconfig
# nothing here

CONFIG_CLOCK_CONTROL_NRF_K32SRC_XTAL=y
CONFIG_SOC_NRF_FORCE_CONSTLAT=n
CONFIG_CLOCK_CONTROL_NRF_K32SRC_SYNTH=n
CONFIG_POWEROFF=y #this makes grtc driver not force syscounter on all the time, remove when https://github.com/nrfconnect/sdk-nrf-next/pull/2132 is merged
```

## boards/nrf54l15dk_nrf54l15_cpuapp.overlay
```dts
/*
 * Copyright (c) 2024 Nordic Semiconductor ASA
 *
 * SPDX-License-Identifier: LicenseRef-Nordic-5-Clause
 */

// TODO: re-enable HWFC once it's fixed
&uart20 {
	status = "disabled";
};
```

## src/main.c
```c
/*
 * Copyright (c) Nordic Semiconductor ASA. All Rights Reserved.
 *
 * The information contained herein is confidential property of Nordic Semiconductor ASA.
 * The use, copying, transfer or disclosure of such information is prohibited except by
 * express written agreement with Nordic Semiconductor ASA.
 */

#include <zephyr/kernel.h>
#include <zephyr/sys/poweroff.h>

int main(void)
{
	k_sleep(K_MSEC(1000));

	volatile int i = 10000000;
	while(i){
		i--;
	}

	sys_poweroff();

	return 0;
}
```
